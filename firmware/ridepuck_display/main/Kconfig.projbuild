## firmware/ridepuck_display/main/Kconfig.projbuild
```kconfig
menu "RidePuck Configuration"

    config RIDEPUCK_MOCK_DATA
        bool "Enable on-device mock dashboard data"
        default y
        help
            When enabled, firmware feeds mock ride/navigation state on-device
            for desk testing without a phone connection.

    config RIDEPUCK_MOCK_CYCLE_SCREENS
        bool "Cycle mock screens (ride / no-route) for desk testing"
        depends on RIDEPUCK_MOCK_DATA
        default n
        help
            When enabled, mock data alternates between active navigation
            and no-route states every 10 seconds.

endmenu
```

## firmware/ridepuck_display/sdkconfig.defaults
```kconfig
# RidePuck ESP32-S3 defaults — adjust for your display board

CONFIG_IDF_TARGET="esp32s3"

# PSRAM (required for LVGL double-buffer on round display)
CONFIG_SPIRAM=y
CONFIG_SPIRAM_MODE_OCT=y
CONFIG_SPIRAM_SPEED_80M=y

# Bluetooth
CONFIG_BT_ENABLED=y
CONFIG_BT_BLUEDROID_ENABLED=y
CONFIG_BT_BLE_ENABLED=y
CONFIG_BT_BLE_42_FEATURES_SUPPORTED=y

# FreeRTOS
CONFIG_FREERTOS_HZ=1000

# Log level (reduce in production)
CONFIG_LOG_DEFAULT_LEVEL_INFO=y

# Partition table
CONFIG_PARTITION_TABLE_SINGLE_APP=y

# LVGL
CONFIG_LV_COLOR_DEPTH_16=y
CONFIG_LV_COLOR_16_SWAP=y
CONFIG_LV_FONT_MONTSERRAT_12=y
CONFIG_LV_FONT_MONTSERRAT_14=y
CONFIG_LV_FONT_MONTSERRAT_16=y
CONFIG_LV_FONT_MONTSERRAT_18=y
CONFIG_LV_FONT_MONTSERRAT_20=y
CONFIG_LV_FONT_MONTSERRAT_24=y
CONFIG_LV_FONT_MONTSERRAT_28=y
CONFIG_LV_FONT_MONTSERRAT_48=y

# RidePuck desk prototype defaults
CONFIG_RIDEPUCK_MOCK_DATA=y
```

## firmware/scoutos_display/sdkconfig.defaults
```kconfig
# ScoutOS ESP32-S3 defaults — adjust for your display board

CONFIG_IDF_TARGET="esp32s3"

# Bluetooth
CONFIG_BT_ENABLED=y
CONFIG_BT_BLUEDROID_ENABLED=y
CONFIG_BT_BLE_ENABLED=y

# FreeRTOS
CONFIG_FREERTOS_HZ=1000

# Log level (reduce in production)
CONFIG_LOG_DEFAULT_LEVEL_INFO=y

# Partition table
CONFIG_PARTITION_TABLE_SINGLE_APP=y
```
